## board/Config.in
```kconfig
menu "BSP         Configuration"
choice
    prompt "Board Selection"

source "board/bk7231sdevkitc/Config.in"
if AOS_BOARD_BK7231S
    config AOS_BUILD_BOARD
        default "bk7231sdevkitc"

    source "platform/mcu/bk7231s/Config.in"
    source "platform/arch/arm/armv5/Config.in"
endif

endchoice

endmenu
```
